AUTOSAR XML (schema 4.0)
package /S05FIX/If
  sender receiver interface RemoteCmd
    data val
package /S05FIX/Swc
  application sw component type Telematics
    provide port telToGwOut: provided-interface=RemoteCmd
  application sw component type Gateway
    require port telToGwIn: required-interface=RemoteCmd
  application sw component type SteeringCtrl
  composition sw component type Root
    component tel: type=Telematics
    component gw: type=Gateway
    component steer: type=SteeringCtrl
    connect tel.telToGwOut -> gw.telToGwIn
package /S05FIX/Comm
  pdu telToGwIPdu
    signal telToGwISig: system signal telToGwSSig
  secured i pdu telToGwSecuredIPdu: auth-info-tx-length=32, freshness-value-id=1, freshness-value-length=8, payload=telToGwIPdu
package /S05FIX/Topology
  ecu instance ChassisEcu
  ecu instance GatewayEcu
  ecu instance TelematicsEcu
  system Veh
    root-software-compositions:
      root sw composition prototype Root: software-composition=Root
    system mapping Map: sender-receiver-to-signal-mapping{data-element=Root.telToGwOut.val, system-signal=telToGwSSig}
      sw-mappings:
        swc to ecu mapping ToChassisEcu: component=steer, ecu-instance=ChassisEcu
        swc to ecu mapping ToGatewayEcu: component=gw, ecu-instance=GatewayEcu
        swc to ecu mapping ToTelematicsEcu: component=tel, ecu-instance=TelematicsEcu
