AUTOSAR XML (schema 4.0)
package /S08DEAS/If
  sender receiver interface SomeIpDiscover
    data val
package /S08DEAS/Swc
  application sw component type ServiceConsumer
    provide port discoverOut: provided-interface=SomeIpDiscover
  application sw component type AdasService
    require port discoverIn: required-interface=SomeIpDiscover
  composition sw component type Root
    component consumer: type=ServiceConsumer
    component provider: type=AdasService
    connect consumer.discoverOut -> provider.discoverIn
package /S08DEAS/Comm
  pdu discoverIPdu
    signal discoverISig: system signal discoverSSig
  secured i pdu discoverSecuredIPdu: auth-info-tx-length=32, freshness-value-id=1, freshness-value-length=8, payload=discoverIPdu
package /S08DEAS/Topology
  ecu instance AdasEcu
  ecu instance GatewayEcu
  system Veh
    root-software-compositions:
      root sw composition prototype Root: software-composition=Root
    system mapping Map: sender-receiver-to-signal-mapping{data-element=Root.discoverOut.val, system-signal=discoverSSig}
      sw-mappings:
        swc to ecu mapping ToAdasEcu: component=provider, ecu-instance=AdasEcu
        swc to ecu mapping ToGatewayEcu: component=consumer, ecu-instance=GatewayEcu
