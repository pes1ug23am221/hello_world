AUTOSAR XML (schema 4.0)
package /S02CONN/If
  sender receiver interface RemoteSvc
    data val
package /S02CONN/Swc
  application sw component type TelematicsUnit
    provide port tcuToGwOut: provided-interface=RemoteSvc
  application sw component type CentralGateway
    require port tcuToGwIn: required-interface=RemoteSvc
  application sw component type ChassisCtrl
  composition sw component type Root
    component tcu: type=TelematicsUnit
    component cgw: type=CentralGateway
    component chassis: type=ChassisCtrl
    connect tcu.tcuToGwOut -> cgw.tcuToGwIn
package /S02CONN/Comm
  pdu tcuToGwIPdu
    signal tcuToGwISig: system signal tcuToGwSSig
  secured i pdu tcuToGwSecuredIPdu: auth-info-tx-length=32, freshness-value-id=1, freshness-value-length=8, payload=tcuToGwIPdu
package /S02CONN/Topology
  ecu instance ChassisEcu
  ecu instance GatewayEcu
  ecu instance TcuEcu
  system Veh
    root-software-compositions:
      root sw composition prototype Root: software-composition=Root
    system mapping Map: sender-receiver-to-signal-mapping{data-element=Root.tcuToGwOut.val, system-signal=tcuToGwSSig}
      sw-mappings:
        swc to ecu mapping ToChassisEcu: component=chassis, ecu-instance=ChassisEcu
        swc to ecu mapping ToGatewayEcu: component=cgw, ecu-instance=GatewayEcu
        swc to ecu mapping ToTcuEcu: component=tcu, ecu-instance=TcuEcu
