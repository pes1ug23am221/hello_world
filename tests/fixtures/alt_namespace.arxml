AUTOSAR XML (schema 3.1.4)
package /T/If
  sender receiver interface Speed
    data value
package /T/Swc
  application sw component type Sensor
    provide port Out: provided-interface=Speed
  application sw component type Brake
    require port In: required-interface=Speed
  composition sw component type Top
    component s: type=Sensor
    component b: type=Brake
    connect s.Out -> b.In
