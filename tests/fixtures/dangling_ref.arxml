AUTOSAR XML (schema 4.0)
package /T/Swc
  application sw component type Orphan
    require port In: required-interface=Missing
  composition sw component type Top
    component o: type=Orphan
    component ghost: type=Missing
