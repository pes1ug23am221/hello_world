AUTOSAR XML (schema 4.0)
package /T/Topology
  ecu instance BodyEcu
    can communication connector CanConn
  ecu instance DoorEcu
    can communication connector CanConn
  system Veh
    root-software-compositions:
      root sw composition prototype RootProto: software-composition=Top
    system mapping Map
      sw-mappings:
        swc to ecu mapping ToBody: component=RootProto.ctrl, ecu-instance=BodyEcu
        swc to ecu mapping ToDoor: component=[RootProto.dl, RootProto.dr], ecu-instance=DoorEcu
