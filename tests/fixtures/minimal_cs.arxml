AUTOSAR XML (schema 4.0)
package /T/If
  client server interface Unlock
    operation doUnlock
package /T/Swc
  application sw component type LockActuator
    provide port Svc: provided-interface=Unlock
  application sw component type Telematics
    require port Call: required-interface=Unlock
  composition sw component type Top
    component lock: type=LockActuator
    component tel: type=Telematics
    connect lock.Svc -> tel.Call
