AUTOSAR XML (schema 4.0)
package /B/If
  sender receiver interface Tel
    data cmd
    data diag
    data spare
package /B/Swc
  application sw component type Head
    provide port Out: provided-interface=Tel
  application sw component type Gw
    require port In: required-interface=Tel
  composition sw component type Sys
    component head: type=Head
    component gw: type=Gw
    connect head.Out -> gw.In
package /B/Comm
  system signal OrphanSSig
  pdu CmdIPdu
    signal CmdISig: system signal CmdSSig
  pdu DiagIPdu
    signal DiagISig: system signal DiagSSig
  secured i pdu CmdSecuredIPdu: auth-info-tx-length=32, freshness-value-id=1, freshness-value-length=8, payload=CmdIPdu
package /B/Topology
  ecu instance HeadUnit
  ecu instance Gateway
  system Veh
    root-software-compositions:
      root sw composition prototype Root: software-composition=Sys
    system mapping Map
      data-mappings:
        data-element=Root.Out.cmd, system-signal=CmdSSig
        data-element=Root.Out.diag, system-signal=DiagSSig
        data-element=Root.Out.spare, system-signal=OrphanSSig
      sw-mappings:
        swc to ecu mapping ToHead: component=head, ecu-instance=HeadUnit
        swc to ecu mapping ToGw: component=gw, ecu-instance=Gateway
