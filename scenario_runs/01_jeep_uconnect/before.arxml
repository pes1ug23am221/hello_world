AUTOSAR XML (schema 4.0)
package /S01UCON/If
  sender receiver interface CellLink
    data val
package /S01UCON/Swc
  application sw component type Telematics
    provide port cellToHuOut: provided-interface=CellLink
  application sw component type HeadUnit
    require port cellToHuIn: required-interface=CellLink
  application sw component type V850Bridge
  application sw component type SteeringCtrl
  composition sw component type Root
    4 x component:
      tel: type=Telematics
      ivi: type=HeadUnit
      bridge: type=V850Bridge
      steer: type=SteeringCtrl
    connect tel.cellToHuOut -> ivi.cellToHuIn
package /S01UCON/Topology
  ecu instance ChassisEcu
  ecu instance GatewayEcu
  ecu instance TelematicsEcu
  system Veh
    root-software-compositions:
      root sw composition prototype Root: software-composition=Root
    system mapping Map
      sw-mappings:
        swc to ecu mapping ToChassisEcu: component=steer, ecu-instance=ChassisEcu
        swc to ecu mapping ToGatewayEcu: component=bridge, ecu-instance=GatewayEcu
        swc to ecu mapping ToTelematicsEcu: component=[tel, ivi], ecu-instance=TelematicsEcu
