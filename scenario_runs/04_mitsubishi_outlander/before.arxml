AUTOSAR XML (schema 4.0)
package /S04OUTL/If
  sender receiver interface AppCmd
    data val
package /S04OUTL/Swc
  application sw component type WifiModule
    provide port wifiToAlarmOut: provided-interface=AppCmd
  application sw component type AlarmCtrl
    require port wifiToAlarmIn: required-interface=AppCmd
  composition sw component type Root
    component wifi: type=WifiModule
    component alarm: type=AlarmCtrl
    connect wifi.wifiToAlarmOut -> alarm.wifiToAlarmIn
package /S04OUTL/Comm
  pdu wifiToAlarmIPdu
    signal wifiToAlarmISig: system signal wifiToAlarmSSig
package /S04OUTL/Topology
  ecu instance BodyEcu
  ecu instance TelematicsEcu
  system Veh
    root-software-compositions:
      root sw composition prototype Root: software-composition=Root
    system mapping Map: sender-receiver-to-signal-mapping{data-element=Root.wifiToAlarmOut.val, system-signal=wifiToAlarmSSig}
      sw-mappings:
        swc to ecu mapping ToBodyEcu: component=alarm, ecu-instance=BodyEcu
        swc to ecu mapping ToTelematicsEcu: component=wifi, ecu-instance=TelematicsEcu
