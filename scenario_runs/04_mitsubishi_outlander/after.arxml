AUTOSAR XML (schema 4.0)
package /S04OUTL/If
  sender receiver interface AppCmd
    data val
package /S04OUTL/Swc
  application sw component type GsmModule
    provide port gsmToAlarmOut: provided-interface=AppCmd
  application sw component type AlarmCtrl
    require port gsmToAlarmIn: required-interface=AppCmd
  composition sw component type Root
    component gsm: type=GsmModule
    component alarm: type=AlarmCtrl
    connect gsm.gsmToAlarmOut -> alarm.gsmToAlarmIn
package /S04OUTL/Comm
  pdu gsmToAlarmIPdu
    signal gsmToAlarmISig: system signal gsmToAlarmSSig
  secured i pdu gsmToAlarmSecuredIPdu: auth-info-tx-length=32, freshness-value-id=1, freshness-value-length=8, payload=gsmToAlarmIPdu
package /S04OUTL/Topology
  ecu instance BodyEcu
  ecu instance TelematicsEcu
  system Veh
    root-software-compositions:
      root sw composition prototype Root: software-composition=Root
    system mapping Map: sender-receiver-to-signal-mapping{data-element=Root.gsmToAlarmOut.val, system-signal=gsmToAlarmSSig}
      sw-mappings:
        swc to ecu mapping ToBodyEcu: component=alarm, ecu-instance=BodyEcu
        swc to ecu mapping ToTelematicsEcu: component=gsm, ecu-instance=TelematicsEcu
